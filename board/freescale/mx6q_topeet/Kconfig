## board/freescale/mx6q_topeet/Kconfig
```kconfig
if TARGET_MX6Q_TOPEET || TARGET_MX6SABRESD_COMMON

config SYS_BOARD
	default "mx6q_topeet"

config SYS_VENDOR
	default "freescale"

config SYS_CONFIG_NAME
	default "mx6q_topeet"

config SYS_TEXT_BASE
    default 0x17800000

endif
```
